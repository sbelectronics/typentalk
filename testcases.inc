void execute_test_cases() {
  test("a", "A1 AY Y");
  test("b", "B E1 AY Y");
  test("c", "S E1 AY Y");
  test("d", "D E1 AY Y");
  test("e", "E1 Y");
  test("f", "EH1 EH2 F");
  test("g", "D J E1 AY Y");
  test("h", "A1 AY Y T CH");
  test("i", "AH1 EH3 I3 Y");
  test("j", "D J EH A1 AY Y");
  test("k", "K EH1 A1 AY Y");
  test("l", "EH1 EH3 UH3 L");
  test("m", "EH1 EH2 M");
  test("n", "EH1 EH3 N");
  test("o", "O1 U1");
  test("p", "P E1 AY Y");
  test("q", "K Y1 IU U1 U1");
  test("r", "AH1 UH2 ER");
  test("s", "EH1 EH2 S");
  test("t", "T E1 AY Y");
  test("u", "Y1 IU U1 U1");
  test("v", "V E1 AY Y");
  test("w", "D UH1 B UH3 L Y1 IU U1");
  test("x", "EH1 EH2 K PA0 S");
  test("y", "W AH1 EH3 I3 Y");
  test("z", "Z E1 AY Y");
  test("1", "W UH1 UH2 N");
  test("2", "T IU U1 U1");
  test("3", "TH R E1 Y");
  test("4", "F O1 O2 R");
  test("5", "F AH1 EH3 Y V");
  test("6", "S I1 I3 K PA0 S");
  test("7", "S EH1 V I2 N");
  test("8", "A1 AY Y T");
  test("9", "N AH1 EH3 Y N");
  test("0", "Z AY I1 R O1 U1");
  test("advertise", "AE1 EH3 D V ER T AH1 EH3 AY Z");
  test("awesome", "AW EH1 EH3 S UH1 UH3 M");
  test("ball", "B AW L");
  test("balloon", "B AW L U1 U1 N");
  test("baker", "B A1 AY Y K ER");
  test("base", "B A1 AY Y S");
  test("brekfast", "B R EH1 EH3 K F AE1 EH3 S T");
  test("bring", "B R I1 I3 NG");
  test("butiful", "PA1 PA1 B Y1 IU U1 T I1 I3 F OO1 L");
  test("cat", "K AE1 EH3 T");
  test("certin", "S ER T I1 I3 N");
  test("computer", "K AH1 UH3 M P OO1 OO1 T ER");
  test("doctor", "D AH1 UH3 K T ER");
  test("dog", "D AW G");
  test("every", "EH1 V ER Y");
  test("exit", "EH1 EH3 K PA0 S I1 I3 T");
  test("far", "F AH1 UH3 R");
  test("for", "PA1 F O1 O2 R");
  test("fortran", "PA1 F O1 O2 R T R AE1 EH3 N");
  test("go", "G O1 U1");
  test("hotel", "H AH1 UH3 T EH1 EH3 L");
  test("india", "I1 N D I1 I3 UH2 UH3");
  test("joe", "D J O1 U1");
  test("joeseph", "D J O1 U1 EH1 EH3 Z EH1 EH3 F");
  test("just", "D J UH3 UH2 S T");
  test("kilogram", "K I1 I3 L AH1 UH3 G R AE1 EH3 M");
  test("kilometer", "K I1 I3 L UH3 M I3 T ER");
  test("lima", "L I1 I3 M UH2 UH3");
  test("lime", "L AH1 EH3 Y M");
  test("loose", "L U1 U1 Z");
  test("lonely", "L O1 U1 N L Y");
  test("lose", "L O1 U1 Z");
  test("lost", "L AW S T");
  test("mistake", "M I1 I3 S T A1 I3 AY K");
  test("mosheenery", "M AH1 UH3 SH E1 Y N ER Y");
  test("near", "N E1 Y R");
  test("nebraska", "N EH1 EH3 B R AE1 EH3 S K UH2 UH3");
  test("next", "N EH1 EH3 K PA0 S T");
  test("north", "N O1 O2 R TH");
  test("nose", "N O1 U1 Z");
  test("pronunsiation", "P R UH1 N UH3 UH2 N S I1 I3 A1 Y SH UH3 N");
  test("prowceejers", "P R O1 U1 S E1 Y D J ER Z");
  test("pepper", "P EH1 EH3 P ER");
  test("quail", "K W A1 AY Y L");
  test("question", "K W EH1 EH3 S T CH UH3 N");
  test("round", "R AH1 UH3 W N D");
  test("rodeo", "R AH1 UH3 D Y O1 U1");
  test("rowdeo", "R O1 U1 D Y O1 U1");
  test("scott", "S K AH1 UH3 T");
  test("separate", "S EH1 EH3 P EH3 EH3 ER A1 I3 AY T");
  test("simple", "S I1 I3 M P UH3 L");
  test("some", "S UH1 UH3 M");
  test("south", "S UH3 AH2 U1 TH");
  test("sun", "S UH3 UH2 N");
  test("system", "S I1 S T EH1 EH3 M");
  test("temple", "T EH1 EH3 M P UH3 L");
  test("test", "T EH1 EH3 S T");
  test("thing", "TH I1 I3 NG");
  test("things", "TH I1 I3 NG Z");
  test("time", "T AH1 EH3 Y M");
  test("timeless", "T I1 M EH1 EH3 L EH1 EH3 S");
  test("timely", "T I1 M L Y");
  test("toast", "T O1 U1 S T");
  test("toggle", "T AW G UH3 L");
  test("top", "T AH1 UH3 P");
  test("tower", "T O1 U1 ER");
  test("type", "T AH1 EH3 I3 Y P");
  test("to", "PA1 T IU U1");
  test("unique", "Y1 IU U1 N AY Y K");
  test("use", "Y1 IU U1 Z");
  test("useless", "Y1 IU U1 Z EH1 EH3 L EH1 EH3 S");
  test("user", "Y1 IU U1 Z ER");
  test("utah", "Y1 IU U1 T AE1 EH3");
  test("votrax", "V O2 O2 T R AE1 EH3 K PA0 S");
  test("who", "H IU U1 U1");
  test("xerxes", "K PA0 S ER K PA0 S I3 Z");
  test("xilophone", "K PA0 S I1 I3 L AH1 UH3 F O1 U1 N");
  test("zany", "Z EH2 EH2 N Y");
  test("zero", "Z EH1 R O1 U1");
  test("zoo", "Z U1 U1");
  test("zone", "Z O1 U1 N");
}
