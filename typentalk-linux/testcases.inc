void execute_test_cases() {
  test("a", "A1 AY Y");
  test("b", "B E1 AY Y");
  test("c", "S E1 AY Y");
  test("d", "D E1 AY Y");
  test("e", "E1 Y");
  test("f", "EH1 EH2 F");
  test("g", "D J E1 AY Y");
  test("h", "A1 AY Y T CH");
  test("i", "AH1 EH3 I3 Y");
  test("j", "D J EH A1 AY Y");
  test("k", "K EH1 A1 AY Y");
  test("l", "EH1 EH3 UH3 L");
  test("m", "EH1 EH2 M");
  test("n", "EH1 EH3 N");
  test("o", "O1 U1");
  test("p", "P E1 AY Y");
  test("q", "K Y1 IU U1 U1");
  test("r", "AH1 UH2 ER");
  test("s", "EH1 EH2 S");
  test("t", "T E1 AY Y");
  test("u", "Y1 IU U1 U1");
  test("v", "V E1 AY Y");
  test("w", "D UH1 B UH3 L Y1 IU U1");
  test("x", "EH1 EH2 K PA0 S");
  test("y", "W AH1 EH3 I3 Y");
  test("z", "Z E1 AY Y");
  test("1", "W UH1 UH2 N");
  test("2", "T IU U1 U1");
  test("3", "TH R E1 Y");
  test("4", "F O1 O2 R");
  test("5", "F AH1 EH3 Y V");
  test("6", "S I1 I3 K PA0 S");
  test("7", "S EH1 V I2 N");
  test("8", "A1 AY Y T");
  test("9", "N AH1 EH3 Y N");
  test("0", "Z AY I1 R O1 U1");
  test("one", "W UH1 UH2 N");
  test("two", "T IU U1");
  test("three", "TH R E1 Y");
  test("four", "F O1 O2 R");
  test("five", "F AH1 EH3 Y V");
  test("six", "S I1 I3 K PA0 S");
  test("seven", "S EH1 EH3 V EH1 EH3 N");
  test("eight", "EH3 A1 Y T");
  test("nine", "N AH1 EH3 Y N");
  test("ten", "T EH1 EH3 N");
  test("123", "W UH1 UH2 N T IU U1 U1 TH R E1 Y");
  test("a1", "A1 AY Y W UH1 UH2 N");
  test("a1a", "A1 AY Y W UH1 UH2 N A1 AY Y");
  test("alpha,", "AW L F UH2 UH3 PA1 PA1");
  test(",alpha", "PA1 PA1 AW L F UH2 UH3");
  test("advertise", "AE1 EH3 D V ER T AH1 EH3 AY Z");
  test("aether", "AE1 EH3 EH1 EH3 THV ER");
  test("aid", "A1 AY Y D");
  test("all", "AW L");
  test("aloud", "UH1 L AH1 UH3 W D");
  test("anemone", "AE1 EH3 N EH1 EH3 M O1 U1 N");
  test("aptly", "AE1 EH3 P T L Y");
  test("awesome", "AW EH1 EH3 S UH1 UH3 M");
  test("ball", "B AW L");
  test("balloon", "B AW L U1 U1 N");
  test("baker", "B A1 AY Y K ER");
  test("base", "B A1 AY Y S");
  test("brekfast", "B R EH1 EH3 K F AE1 EH3 S T");
  test("bring", "B R I1 I3 NG");
  test("broadcast", "B R O1 U1 D K AE1 EH3 S T");
  test("butiful", "PA1 PA1 B Y1 IU U1 T I1 I3 F OO1 L");
  test("cat", "K AE1 EH3 T");
  test("certin", "S ER T I1 I3 N");
  test("chomp", "T CH AH1 UH3 M P");
  test("computer", "K AH1 UH3 M P OO1 OO1 T ER");
  test("church", "T CH ER T CH");
  test("coffee", "K AW F E1 Y");
  test("come", "K UH1 UH3 M");
  test("country", "K AH1 UH3 W N T R Y");
  test("day", "D A1 I3 AY");
  test("delete", "D Y L I3 T");
  test("doctor", "D AH1 UH3 K T ER");
  test("dog", "D AW G");
  test("educated", "EH1 EH3 D IU U1 K A1 I3 AY T I3 D");
  test("education", "EH1 EH3 D IU U1 K A1 Y SH UH3 N");
  test("either", "E1 THV ER");
  test("electroanalysis", "EH1 EH3 L EH1 EH3 K T R O1 U1 N AE1 EH3 L I1 Z I1 I3 S");
  test("emergency", "EH1 EH3 M ER D J EH1 EH3 N S Y");
  test("every", "EH1 V ER Y");
  test("example", "EH1 EH3 K PA0 S AE1 EH3 M P UH3 L");
  test("exit", "EH1 EH3 K PA0 S I1 I3 T");
  test("far", "F AH1 UH3 R");
  test("flywheel", "F L I1 W E1 Y L");
  test("for", "PA1 F O1 O2 R");
  test("fortran", "PA1 F O1 O2 R T R AE1 EH3 N");
  test("gave", "G A1 AY Y V");
  test("give", "G I1 I3 V");
  test("go", "G O1 U1");
  test("good", "G OO1 OO1 D");
  test("half", "H AE1 EH3 F");
  test("have", "PA1 PA1 H AE1 EH3 V");
  test("hoard", "H O1 U1 R D");
  test("hotel", "H AH1 UH3 T EH1 EH3 L");
  test("if", "PA1 PA1 I1 I3 F");
  test("image", "I1 I3 M I1 D J");
  test("imagery", "I1 I3 M I1 D J ER Y");
  test("imagined", "I1 I3 M AE1 EH3 D J AH1 EH3 Y N D");
  test("india", "I1 N D I1 I3 UH2 UH3");
  test("information", "I1 N F O1 O2 R M A1 Y SH UH3 N");
  test("isthmus", "I1 I3 S TH M UH3 UH2 S");
  test("joe", "D J O1 U1");
  test("joeseph", "D J O1 U1 EH1 EH3 Z EH1 EH3 F");
  test("just", "D J UH3 UH2 S T");
  test("kaleidoscopes", "K A1 Y L E1 D AH1 UH3 S K O1 U1 P S");
  test("kilogram", "K I1 I3 L AH1 UH3 G R AE1 EH3 M");
  test("kilometer", "K I1 I3 L UH3 M I3 T ER");
  test("kitchen", "K I1 I3 T T CH EH1 EH3 N");
  test("kitten", "K I1 I3 T EH1 EH3 N");
  test("knife", "N UH3 AH2 Y F");
  test("knock", "N AH1 UH3 K");
  test("know", "N O1 U1");
  test("lima", "L I1 I3 M UH2 UH3");
  test("lime", "L AH1 EH3 Y M");
  test("loose", "L U1 U1 Z");
  test("lonely", "L O1 U1 N L Y");
  test("lose", "L O1 U1 Z");
  test("lost", "L AW S T");
  test("lymph", "L I1 M F");
  test("magazine", "M AE1 EH3 G AE1 EH3 Z AH1 EH3 Y N");
  test("medication", "M EH1 EH3 D I1 I3 K A1 Y SH UH3 N");
  test("men", "M EH1 EH3 N");
  test("mingle", "M I1 I3 NG G UH3 L");
  test("mingles", "M I1 I3 NG G UH3 L Z");
  test("mingling", "M I1 I3 NG G UH3 L I1 I3 NG");
  test("mischievious", "M I1 I3 S T CH AY Y V I1 I3 UH3 S");
  test("mistake", "M I1 I3 S T A1 I3 AY K");
  test("mosheenery", "M AH1 UH3 SH E1 Y N ER Y");
  test("muscle", "M UH3 UH2 S K UH3 L");
  test("near", "N E1 Y R");
  test("nebraska", "N EH1 EH3 B R AE1 EH3 S K UH2 UH3");
  test("next", "N EH1 EH3 K PA0 S T");
  test("north", "N O1 O2 R TH");
  test("nose", "N O1 U1 Z");
  test("now", "N AH1 UH3 U1");
  test("of", "PA1 UH1 UH3 V");
  test("open", "O1 P EH1 EH3 N");
  test("ouija", "AH1 UH3 W I1 I3 D J UH2 UH3");
  test("out", "AH1 UH3 W T");
  test("pause", "P AW Z");
  test("playground", "P L A1 I3 AY G R AH1 UH3 W N D");
  test("polygraph", "P AH1 UH3 L I1 G R AE1 EH3 F");
  test("pronunsiation", "P R UH1 N UH3 UH2 N S I1 I3 A1 Y SH UH3 N");
  test("prowceejers", "P R O1 U1 S E1 Y D J ER Z");
  test("pedal", "P EH1 EH3 D UH3 L");
  test("pepper", "P EH1 EH3 P ER");
  test("petal", "P EH1 EH3 T UH3 L");
  test("quail", "K W A1 AY Y L");
  test("quiet", "K W AH1 EH3 AY I3 T");
  test("question", "K W EH1 EH3 S T CH UH3 N");
  test("round", "R AH1 UH3 W N D");
  test("rodeo", "R AH1 UH3 D Y O1 U1");
  test("rowdeo", "R O1 U1 D Y O1 U1");
  test("rural", "R ER UH3 L");
  test("scott", "S K AH1 UH3 T");
  test("separate", "S EH1 EH3 P EH3 EH3 ER A1 I3 AY T");
  test("simple", "S I1 I3 M P UH3 L");
  test("sing", "S I1 I3 NG");
  test("sings", "S I1 I3 NG Z");
  test("some", "S UH1 UH3 M");
  test("south", "S UH3 AH2 U1 TH");
  test("speed", "S P E1 Y D");
  test("speeded", "S P E1 Y D I3 D");
  test("squash", "S K W AE1 EH3 SH");
  test("storm", "S T O1 O2 R M");
  test("sun", "S UH3 UH2 N");
  test("sunny", "S UH3 UH2 N Y");
  test("system", "S I1 S T EH1 EH3 M");
  test("temple", "T EH1 EH3 M P UH3 L");
  test("tenth", "T EH1 EH3 N TH");
  test("test", "T EH1 EH3 S T");
  test("the", "THV UH1");
  test("their", "THV EH3 A2 EH3 R");
  test("thing", "TH I1 I3 NG");
  test("things", "TH I1 I3 NG Z");
  test("thread", "TH R EH1 EH3 D");
  test("threaded", "TH R EH1 EH3 D D");
  test("time", "T AH1 EH3 Y M");
  test("timeless", "T I1 M EH1 EH3 L EH1 EH3 S");
  test("timely", "T I1 M L Y");
  test("toast", "T O1 U1 S T");
  test("toggle", "T AW G UH3 L");
  test("tooth", "T U1 U1 TH");
  test("top", "T AH1 UH3 P");
  test("tower", "T O1 U1 ER");
  test("type", "T AH1 EH3 I3 Y P");
  test("to", "PA1 T IU U1");
  test("unique", "Y1 IU U1 N AY Y K");
  test("use", "Y1 IU U1 Z");
  test("useless", "Y1 IU U1 Z EH1 EH3 L EH1 EH3 S");
  test("user", "Y1 IU U1 Z ER");
  test("utah", "Y1 IU U1 T AE1 EH3");
  test("variety", "V EH3 EH3 ER AH1 EH3 AY I3 T Y");
  test("vary", "V EH3 EH3 ER Y");
  test("venison", "V EH1 EH3 N I1 I3 Z UH3 N");
  test("very", "V EH1 R Y");
  test("votrax", "V O2 O2 T R AE1 EH3 K PA0 S");
  test("walked", "W AW K T");
  test("who", "H IU U1 U1");
  test("xerxes", "K PA0 S ER K PA0 S I3 Z");
  test("xilophone", "K PA0 S I1 I3 L AH1 UH3 F O1 U1 N");
  test("zany", "Z EH2 EH2 N Y");
  test("zero", "Z EH1 R O1 U1");
  test("zoo", "Z U1 U1");
  test("zone", "Z O1 U1 N");
}
